## conf/layer.conf
```bitbake
BBPATH .= ":${LAYERDIR}"
BBFILES += "${LAYERDIR}/recipes-*/*/*.bb ${LAYERDIR}/recipes-*/*/*.bbappend"

LICENSE_PATH += "${LAYERDIR}/files/licenses"
GPLv2_LICENSE_CHECKSUM = "b234ee4d69f5fce4486a80fdaf4a4263"
GPLv2_LICENSE_PATH = "${LAYERDIR}/files/licenses/GPLv2"
```
